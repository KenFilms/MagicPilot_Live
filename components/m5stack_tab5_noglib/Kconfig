## components/m5stack_tab5_noglib/Kconfig
```kconfig
menu "Board Support Package (M5Stack Tab5)"

    config BSP_ERROR_CHECK
        bool "Enable error check in BSP"
        default y
        help
            Error check assert the application before returning the error code.
    menu "I2C"
        config BSP_I2C_NUM
            int "I2C peripheral index"
            default 1
            range 0 1
            help
                Pick the I2C you want to use.
    endmenu
    menu "Display"
        config BSP_DISPLAY_BRIGHTNESS_LEDC_CH
        int "LEDC channel index"
        default 1
        range 0 7
        help
            LEDC channel is used to generate PWM signal that controls display brightness.
            Set LEDC index that should be used.

        config BSP_LCD_DRAW_BUF_HEIGHT
        int "LCD framebuf height"
        default 50
        range 10 240
        help
            Framebuf is used for lvgl rendering output.

        config BSP_LCD_DRAW_BUF_DOUBLE
        bool "LCD double framebuf"
        default y
        help
            Whether to enable double framebuf.
        config BSP_LCD_USE_DMA2D
            bool "Select whether to use DMA2D"
            default "y"
            help
                Select whether to use DMA2D to draw the bitmap.
        config BSP_LCD_DPI_BUFFER_NUMS
            int "Set number of frame buffers"
            default 1
            range 1 3
            help
                Let DPI LCD driver create a specified number of frame-size buffers. Only when it is set to multiple can the avoiding tearing be turned on.

        config BSP_LCD_REFRESH_HZ
            int "Panel refresh rate (Hz, 0 = stock timing)"
            default 0
            range 0 70
            help
                [Local patch] Lengthens or shortens the vertical front porch so the panel refreshes
                at about this rate. 0 keeps the stock timing (ILI9881C ~48 Hz, ST7123/ST7121 ~58 Hz).
                A lower rate frees PSRAM bandwidth (scan-out reads the whole frame buffer every
                refresh) and lets video run at an even cadence (e.g. 2 refreshes per frame).

        config BSP_DISPLAY_LVGL_AVOID_TEAR
            bool "Avoid tearing effect"
            depends on BSP_LCD_DPI_BUFFER_NUMS > 1
            default "n"
            help
                Avoid tearing effect through LVGL buffer mode and double frame buffers of LCD.

        choice BSP_DISPLAY_LVGL_MODE
            depends on BSP_DISPLAY_LVGL_AVOID_TEAR
            prompt "Select LVGL buffer mode"
            default BSP_DISPLAY_LVGL_FULL_REFRESH
            config BSP_DISPLAY_LVGL_FULL_REFRESH
                bool "Full refresh"
            config BSP_DISPLAY_LVGL_DIRECT_MODE
                bool "Direct mode"
        endchoice
    endmenu
endmenu
```

## main/Kconfig.projbuild
```kconfig
menu "MagicPilot LIVE"

    config HDMI_PREFERRED_WIDTH
        int "Preferred capture width"
        default 1280
        help
            The UVC format closest to this resolution is requested from the HDMI capture
            adapter. 1280x720 maps 1:1 onto the Tab5 screen (no scaling).

    config HDMI_PREFERRED_HEIGHT
        int "Preferred capture height"
        default 720

    config HDMI_PREFERRED_FPS
        int "Preferred capture frame rate"
        default 30
        range 1 60

    choice HDMI_SCALE_MODE
        prompt "Scaling mode"
        default HDMI_SCALE_FILL
        help
            The PPA scaler works in 1/16 steps. If the source cannot be scaled exactly to
            1280x720, FILL crops a few edge pixels so the picture covers the whole screen,
            FIT keeps the whole picture (aspect ratio preserved) and adds black borders.

        config HDMI_SCALE_FILL
            bool "Fill whole screen"
        config HDMI_SCALE_FIT
            bool "Fit (letterbox, keep aspect ratio)"
    endchoice

    choice HDMI_ROTATION
        prompt "Landscape orientation"
        default HDMI_ROTATION_90
        help
            The Tab5 panel is natively portrait (720x1280). Select the other option if the
            picture appears upside down.

        config HDMI_ROTATION_90
            bool "Rotate 90 degrees"
        config HDMI_ROTATION_270
            bool "Rotate 270 degrees"
    endchoice

    config HDMI_TOUCH_FLIP
        bool "Turn touch input by 180 degrees"
        default n
        help
            Enable if taps land on the opposite side of the screen (touch panel mounted the other
            way round than the display on some Tab5 revisions).

    config HDMI_JPEG_SWAP_RB
        bool "Swap red/blue of decoded MJPEG frames"
        default n
        help
            Enable if red and blue appear swapped when the adapter streams MJPEG.

    config HDMI_BACKLIGHT_PERCENT
        int "Display backlight (%)"
        default 100
        range 10 100

    menu "Performance"

        choice HDMI_PACING
            prompt "Frame pacing"
            default HDMI_PACING_AUTO
            help
                Present new frames on a fixed cadence of panel refreshes, so every frame stays on
                screen equally long. Uneven cadence (2,3,2,3... refreshes) is seen as judder.

            config HDMI_PACING_OFF
                bool "Off (show each frame as soon as it is ready)"
            config HDMI_PACING_AUTO
                bool "Auto (from measured render time and source frame rate)"
            config HDMI_PACING_FIXED
                bool "Fixed number of refreshes per frame"
        endchoice

        config HDMI_PACING_REFRESHES
            int "Refreshes per frame"
            depends on HDMI_PACING_FIXED
            default 3
            range 1 6

        config HDMI_BAND_RENDER
            bool "Render in bands through internal SRAM"
            default y
            help
                The PPA reads PSRAM slowly (~46 MB/s) but internal SRAM quickly. In band mode an
                AXI GDMA (~114 MB/s from PSRAM) copies bands of source rows into internal SRAM and
                the PPA rotates each band from there into the frame buffer, overlapped with the
                copy of the next band. Used for 2-byte formats (RGB565, YUY2) when the vertical
                scale is an integer (1280x720, 640x360, ...); other cases use the direct path.

        config HDMI_BAND_ROWS
            int "Maximum source rows per band"
            depends on HDMI_BAND_RENDER
            default 32
            range 4 64
            help
                Three band buffers of 1280 x rows x 2 bytes are allocated in internal SRAM (the GDMA
                fills one, the CPU composites the overlay into one, the PPA rotates one).

    endmenu

endmenu
```
